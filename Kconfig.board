## Kconfig.board
```kconfig
# Adafruit Itsybitsy M0 board configuration

# Copyright (c) 2018 Google LLC.
# SPDX-License-Identifier: Apache-2.0

config BOARD_ADAFRUIT_ITSYBITSY_M0
	bool "Adafruit itsybitsy M0"
	depends on SOC_PART_NUMBER_SAMD21G18A
```

## Kconfig.defconfig
```kconfig
# Adafruit Itsybitsy M0 board configuration

# Copyright (c) 2018 Google LLC.
# SPDX-License-Identifier: Apache-2.0

config BOARD
	default "adafruit_itsybitsy_m0"
	depends on BOARD_ADAFRUIT_ITSYBITSY_M0
```
